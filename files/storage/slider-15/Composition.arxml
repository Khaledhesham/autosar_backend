AUTOSAR XML (schema 3-2-1)
package /CrossControl/SoftwareComponents
  composition type sliderComposition
    component slid1: type=slid1
