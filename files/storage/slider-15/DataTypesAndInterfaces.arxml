AUTOSAR XML (schema 3-2-1)
standard types defined: UInt8
package /slider/Interfaces
  sender receiver interface I1
    data gyf: type=UInt8
  sender receiver interface dsa
    data sdds: type=UInt8
