AUTOSAR XML (schema 3-2-1)
standard types defined: Boolean
package /test/Interfaces
  sender receiver interface dsa
    data dsa: type=Boolean
    data ds: type=Boolean
    data fg: type=Boolean
  sender receiver interface dsadsa
    data s: type=Boolean
    data d: type=Boolean
    data f: type=Boolean
