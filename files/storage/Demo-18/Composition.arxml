AUTOSAR XML (schema 3-2-1)
package /CrossControl/SoftwareComponents
  composition type DemoComposition
    component DemoSWC: type=DemoSWC
    component DemoSWC2: type=DemoSWC2
    connect DemoSWC.DemoPPort -> DemoSWC2.DemoRequester
