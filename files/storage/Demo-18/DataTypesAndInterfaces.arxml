AUTOSAR XML (schema 3-2-1)
standard types defined: Boolean, UInt8
package /Demo/Interfaces
  sender receiver interface DemoInterface
    data DemoDE: type=UInt8
