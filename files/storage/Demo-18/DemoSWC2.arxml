AUTOSAR XML (schema 3-2-1)
package /Demo/DemoSWC2_swc
  application software component type DemoSWC2
    require port DemoRequester
  internal behavior DemoSWC2Behavior: component=DemoSWC2
  swc implementation DemoSWC2Implementation: behavior=DemoSWC2Behavior
