AUTOSAR XML (schema 3-2-1)
standard types defined: Boolean
package /seat-heater/Interfaces
  sender receiver interface in
  sender receiver interface internal
  sender receiver interface out
