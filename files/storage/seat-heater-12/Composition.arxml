AUTOSAR XML (schema 3-2-1)
package /CrossControl/SoftwareComponents
  composition type seat-heaterComposition
    component Heater: type=Heater
    component Regulator: type=Regulator
    connect Heater.InternalOutput -> Regulator.InternalInput
