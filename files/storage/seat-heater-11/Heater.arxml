AUTOSAR XML (schema 3-2-1)
package /seat-heater/Heater_swc
  application software component type Heater
    require port test
  internal behavior HeaterBehavior: compontent=Heater
  swc implementation HeaterImplementation: behavior=HeaterBehavior
