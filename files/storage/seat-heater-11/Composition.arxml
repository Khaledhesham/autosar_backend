AUTOSAR XML (schema 3-2-1)
package /CrossControl/SoftwareComponents
  composition type seat-heaterComposition
    component Regulator: type=Regulator
    component Heater: type=Heater
    connect Regulator.Output -> Heater.test
