AUTOSAR XML (schema 3-2-1)
standard types defined: Boolean
package /seat-heater/Interfaces
  sender receiver interface out
