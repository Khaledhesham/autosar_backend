AUTOSAR XML (schema 3-2-1)
package /heater/Blinker_swc
  application software component type Blinker
    provide port Led: provided-com-specs=[{data-element=blinkLed, alive-timeout=60.0}, {data-element=BlinkElement, alive-timeout=60.0}], provided-interface=blink
  internal behavior BlinkerBehavior: compontent=Blinker
    runnable BlinkerRunnable: can-be-invoked-concurrently=true
      data write accesss BlinkerAccess: data-element=Led.BlinkElement
  swc implementation BlinkerImplementation: behavior=BlinkerBehavior
