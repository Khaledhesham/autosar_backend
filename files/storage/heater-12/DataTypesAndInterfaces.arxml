AUTOSAR XML (schema 3-2-1)
standard types defined: Boolean, Float
package /Blink/Interfaces
  sender receiver interface blink
    data BlinkElement: type=Boolean
