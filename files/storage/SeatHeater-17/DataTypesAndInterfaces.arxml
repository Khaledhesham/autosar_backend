AUTOSAR XML (schema 3-2-1)
standard types defined: Boolean, UInt32
package /SeatHeater/Interfaces
  9 x sender receiver interface:
    RegulatorPosition
      data Position: type=UInt32
    HeaterLevel
      data LeftHeatLevel: type=UInt32
      data RightHeatLevel: type=UInt32
    LeftSeatStatusInterface
      data PassengerOnLeftSeat: type=Boolean
    RightSeatStatusInterface
      data PassengerOnRightSeat: type=Boolean
    LeftSensorIOInterface
      data LeftSensorValue: type=Boolean
    RegulatorIOInterface
      data RegulatorValue: type=UInt32
    RightSensorIOInterface
      data RightSensorValue: type=Boolean
    LeftSeatHeaterIOInterface
      data LeftHeaterValue: type=UInt32
    RightSeatHeaterIOInterface
      data RightHeaterValue: type=UInt32
