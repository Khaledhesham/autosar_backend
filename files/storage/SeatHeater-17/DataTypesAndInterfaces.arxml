AUTOSAR XML (schema 3-2-1)
standard types defined: Boolean, UInt32
package /SeatHeater/Interfaces
  4 x sender receiver interface:
    RegulatorPosition
      data Position: type=Boolean
    HeaterLevel
      data LeftHeatLevel: type=Boolean
      data RightHeatLevel: type=Boolean
    LeftSeatStatusInterface
      data PassengerOnLeftSeat: type=Boolean
    RightSeatStatusInterface
      data PassengerOnRightSeat: type=Boolean
