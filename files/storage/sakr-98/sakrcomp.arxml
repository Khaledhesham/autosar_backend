AUTOSAR XML (schema 3-2-1)
package /SoftwareComponent_pkg/SoftwareComponent_swc
  application software component type SoftwareComponent
  internal behavior SoftwareComponentBehavior: compontent=SoftwareComponent
  swc implementation SoftwareComponentImplementation: behavior=SoftwareComponentBehavior
