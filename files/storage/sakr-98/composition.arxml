AUTOSAR XML (schema 3-2-1)
package /CrossControl/SoftwareComponents
  composition type sakrComposition
    component SoftwareComponent: type=SoftwareComponent
