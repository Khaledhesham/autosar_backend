AUTOSAR XML (schema 3-2-1)
standard types defined: Boolean
package /DoubleBlink/Interfaces
  sender receiver interface Input
    data Toggle: type=Boolean
  sender receiver interface Top
    data TopLed: type=Boolean
  sender receiver interface Bottom
    data BottomLed: type=Boolean
