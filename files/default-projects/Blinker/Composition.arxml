AUTOSAR XML (schema 3-2-1)
package /CrossControl/SoftwareComponents
  composition type BlinkComposition
    component Blinker: type=Blinker
