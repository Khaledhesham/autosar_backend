AUTOSAR XML (schema 3-2-1)
package /CrossControl/SoftwareComponents
  composition type SeatHeaterComposition
    5 x component:
      SeatHeatingController: type=SeatHeatingController
      SeatSensorLeft: type=SeatSensorLeft
      SeatSensorRight: type=SeatSensorRight
      HeatRegulator: type=HeatRegulator
      SeatHeater: type=SeatHeater
    connect HeatRegulator.Position -> SeatHeatingController.RegulatorPosition
    connect SeatSensorLeft.StatusLeft -> SeatHeatingController.LeftSeatStatus
    connect SeatHeater.Levels -> SeatHeatingController.HeaterLevels
    connect SeatSensorRight.StatusRight -> SeatHeatingController.RightSeatStatus
